## ch12_kernel-extension/meta-kh-bsp-2/conf/layer.conf
```bitbake
BBPATH   =. "${LAYERDIR}:"
BBFILES  += "${LAYERDIR}/recipes*/*/*.bb"
BBFILES  += "${LAYERDIR}/recipes*/*/*.bbappend"
BBFILES  += "${LAYERDIR}/append/*.bbappend"
BBFILE_COLLECTIONS += "khbsp"
BBFILE_PATTERN_khbsp = "^${LAYERDIR}/"
BBFILE_PRIORITY_khbsp = "6"
LAYERSERIES_COMPAT_khbsp = "${LAYERSERIES_COMPAT_core}"
```

## ch14_customer/meta-kh-project-1/conf/layer.conf
```bitbake
BBPATH =. "${LAYERDIR}:"

BBFILES += "${LAYERDIR}/recipes*/*.bb"
BBFILES += "${LAYERDIR}/recipes*/*/*.bb"
BBFILES += "${LAYERDIR}/recipes*/*/*.bbappend"
BBFILES += "${LAYERDIR}/appends*/*.bbappend"

BBFILE_COLLECTIONS += "kh-project"
BBFILE_PATTERN_kh-project = "^${LAYERDIR}/"
BBFILE_PRIORITY_kh-project = "12"
LAYERSERIES_COMPAT_kh-project = "${LAYERSERIES_COMPAT_core}"
```

## ch2_bitbake/addtask/conf/bblayers.conf
```bitbake
BBLAYERS ?= " \
    /home/kh/repo/yocto-practice/ch2_bitbake/addtask/mylayer \
"
```

## ch2_bitbake/hello_world/conf/bblayers.conf
```bitbake
BBLAYERS ?= " \
    /home/kh/repo/yocto-practice/ch2_bitbake/hello_world/mylayer \
"
```

## ch7_open-embedded/meta-nano-1/conf/layer.conf
```bitbake
BBPATH =. "${LAYERDIR}:"
BBFILES += "${LAYERDIR}/recipes*/*.bb"
BBFILES += "${LAYERDIR}/recipes*/*/*.bbappend"
BBFILE_COLLECTIONS += "nano"
BBFILE_PATTERN_nano = "^${LAYERDIR}/"
BBFILE_PRIORITY_nano = "10"
LAYERSERIES_COMPAT_nano = "${LAYERSERIES_COMPAT_core}"
```

## ch9_packages/build/conf/bblayers.conf
```bitbake
# POKY_BBLAYERS_CONF_VERSION is increased each time build/conf/bblayers.conf
# changes incompatibly
POKY_BBLAYERS_CONF_VERSION = "2"

BBPATH = "${TOPDIR}"
BBFILES ?= ""

BBLAYERS ?= " \
  /home/kh/repo/poky/meta \
  /home/kh/repo/poky/meta-poky \
  /home/kh/repo/poky/meta-yocto-bsp \
  /home/kh/repo/poky/meta-hello \
  /home/kh/repo/poky/meta-nano \
  /home/kh/repo/poky/meta-kh \
  "
```

## ch9_packages/meta-kh-1/conf/layer.conf
```bitbake
BBPATH =. "${LAYERDIR}:"
BBFILES += "${LAYERDIR}/recipes*/*/*.bb"
BBFILES += "${LAYERDIR}/recipes*/*/*.bbappend"
BBFILE_COLLECTIONS += "kh"
BBFILE_PATTERN_kh = "^${LAYERDIR}/"
BBFILE_PRIORITY_kh = "11"
LAYERSERIES_COMPAT_kh = "${LAYERSERIES_COMPAT_core}"
```
